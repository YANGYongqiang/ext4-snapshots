## fs/dext4/Kconfig
```kconfig
config DEXT4_FS
	tristate "dext4 experimental filesystem for defragmentation"
	select JBD2
	select CRC16
	help
	  This is an expperimental filesystem for defragmentation cloned 
	  from ext4.

	  To compile this file system support as a module, choose M here. The
	  module will be called dext4.

	  If unsure, say N.

config DEXT4_USE_FOR_EXT23
	bool "Use ext4 for ext2/ext3 file systems"
	depends on DEXT4_FS
	depends on EXT3_FS=n || EXT2_FS=n
	default y
	help
	  Allow the dext4 file system driver code to be used for ext2 or
	  ext3 file system mounts.  This allows users to reduce their
	  compiled kernel size by using one file system driver for
	  ext2, ext3, and ext4 file systems.

config DEXT4_FS_XATTR
	bool "DExt4 extended attributes"
	depends on DEXT4_FS
	default y
	help
	  Extended attributes are name:value pairs associated with inodes by
	  the kernel or by users (see the attr(5) manual page, or visit
	  <http://acl.bestbits.at/> for details).

	  If unsure, say N.

	  You need this for POSIX ACL support on ext4.

config DEXT4_FS_POSIX_ACL
	bool "DExt4 POSIX Access Control Lists"
	depends on DEXT4_FS_XATTR
	select FS_POSIX_ACL
	help
	  POSIX Access Control Lists (ACLs) support permissions for users and
	  groups beyond the owner/group/world scheme.

	  To learn more about Access Control Lists, visit the POSIX ACLs for
	  Linux website <http://acl.bestbits.at/>.

	  If you don't know what Access Control Lists are, say N

config DEXT4_FS_SECURITY
	bool "DExt4 Security Labels"
	depends on DEXT4_FS_XATTR
	help
	  Security labels support alternative access control models
	  implemented by security modules like SELinux.  This option
	  enables an extended attribute handler for file security
	  labels in the ext4 filesystem.

	  If you are not using a security module that requires using
	  extended attributes for file security labels, say N.

config DEXT4_DEBUG
	bool "DEXT4 debugging support"
	depends on DEXT4_FS
	help
	  Enables run-time debugging support for the ext4 filesystem.

	  If you select Y here, then you will be able to turn on debugging
	  with a command such as "echo 1 > /sys/kernel/debug/ext4/mballoc-debug"
```
